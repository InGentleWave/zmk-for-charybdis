## config/west.yml
```yaml
manifest:
  remotes:
    - name: zmkfirmware
      url-base: https://github.com/zmkfirmware
    - name: DoctorWangWang
      url-base: https://github.com/DoctorWangWang
    - name: bunnyspa # zmk-input-processor-threshold
      url-base: https://github.com/bunnyspa
    - name: zzeneg # zmk-raw-hid
      url-base: https://github.com/zzeneg
  projects:
    - name: zmk
      remote: zmkfirmware
      revision: v0.3
      import: app/west.yml
    - name: zmk-pmw3610-driver
      remote: DoctorWangWang
      revision: main
    - name: zmk-input-processor-threshold
      remote: bunnyspa
      revision: main
      projects:
    - name: zmk-raw-hid
      remote: zzeneg
      revision: master
  self:
    path: config
```
